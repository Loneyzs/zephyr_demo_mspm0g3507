## CMakeLists.txt
```
cmake_minimum_required(VERSION 3.20.0)

# 查找 Zephyr 包（必须在 project() 之前）
find_package(Zephyr REQUIRED HINTS $ENV{ZEPHYR_BASE})

# 定义项目名称
project(zephyr_demo_mspm0g3507)

# 添加源文件
set(APP_SOURCES
    src/main.c
)

target_sources(app PRIVATE ${APP_SOURCES})

# 添加包含目录
target_include_directories(app PRIVATE
    include
)

# 添加编译选项
target_compile_options(app PRIVATE
    -Wall
    -Wextra
)

target_compile_definitions(app PRIVATE
    APP_VERSION_MAJOR=${PROJECT_VERSION_MAJOR}
    APP_VERSION_MINOR=${PROJECT_VERSION_MINOR}
)

# 条件编译：如果启用了调试模式
if(CONFIG_DEBUG)
    target_compile_definitions(app PRIVATE DEBUG_MODE=1)
endif()
```

## prj.conf
```kconfig
# ============================================================================
# Zephyr功能配置
# ============================================================================

# 基础系统配置
CONFIG_SERIAL=y
CONFIG_UART_CONSOLE=y
CONFIG_CONSOLE=y
CONFIG_SYS_CLOCK_TICKS_PER_SEC=1000
CONFIG_MAIN_STACK_SIZE=2048
CONFIG_IDLE_STACK_SIZE=512

# 驱动配置
CONFIG_GPIO=y
CONFIG_I2C=y
CONFIG_SPI=y
CONFIG_PWM=y

# 调试配置
CONFIG_ASSERT=y
CONFIG_STACK_SENTINEL=y
CONFIG_THREAD_MONITOR=y
CONFIG_THREAD_NAME=y

# ============================================================================
# 自定义功能配置
# ============================================================================
```

## boards/lp_mspm0g3507.overlay
```dts
/ {
	aliases {
		led0 = &led0;
	};
};

/* 确保对应的 GPIO 控制器已启用 */
&gpiob {
	status = "okay";
};
```

## src/main.c
```c
#include <zephyr/kernel.h>
#include <zephyr/drivers/gpio.h>

/* 获取设备树中 led0 别名的信息 */
#define LED0_NODE DT_ALIAS(led0)

/* 初始化 GPIO 结构体 */
static const struct gpio_dt_spec led = GPIO_DT_SPEC_GET(LED0_NODE, gpios);

int main(void)
{
	int ret;

	/* 检查设备驱动是否就绪 */
	if (!gpio_is_ready_dt(&led)) {
		return 0;
	}

	/* 配置 GPIO 引脚为输出，并根据 DTS 初始化电平 */
	ret = gpio_pin_configure_dt(&led, GPIO_OUTPUT_ACTIVE);
	if (ret < 0) {
		return 0;
	}

	while (1) {
		/* 翻转 LED 电平 */
		ret = gpio_pin_toggle_dt(&led);
		if (ret < 0) {
			return 0;
		}

		/* 延时 500 毫秒 (0.5s) */
		k_msleep(500);
	}

	return 0;
}
```
